VERSION ""

NS_ :

BS_:

BU_: OXE GPS CH DISP PCM

BO_ 2582647808 ProductInformation: 134 OXE
 SG_ EngineModel : 32|256@1+ (1,0) [0|0] "ascii_hex" Vector__XXX
 SG_ EngineSwVersion : 288|256@1+ (1,0) [0|0] "ascii_hex" Vector__XXX
 SG_ EngineFwVersion : 544|256@1+ (1,0) [0|0] "ascii_hex" Vector__XXX
 SG_ EngineSerialnumber : 800|256@1+ (1,0) [0|0] "ascii_hex" Vector__XXX

BA_DEF_ BO_  "VFrameFormat" ENUM  "StandardCAN","ExtendedCAN","reserved","J1939PG";
BA_DEF_DEF_  "VFrameFormat" "J1939PG";
VAL_ 2634015744 GpcState 0 "GPC_INITIAL" 1 "GPC_PRE_GLOW" 2 "GPC_NO_PRE_GLOW" 3 "GPC_READINESS_GLOW" 4 "GPC_START_GLOW" 5 "GPC_NO_START_GLOW" 6 "GPC_NO_POST_GLOW" 7 "GPC_POST_GLOW" 8 "GPC_GLOW_DONE" ;
VAL_ 2516388864 TemperatueSource 3 "EngineRoom" 14 "ExhaustGas" 129 "IntakeManifold" 130 "Fuel" 131 "Ecu" 132 "CompressorOut" ;
VAL_ 2516388352 PressureSource 0 "Atmospheric" 4 "Hydraulic" 7 "Oil" 8 "FuelRail" ;
VAL_ 2314339584 GearboxGear 0 "Forward" 1 "Neutral" 2 "Reverse" 3 "Unknown" ;
VAL_ 2298438911 GearCommand 0 "Forward" 1 "Neutral" 2 "Reverse" 14 "Error" 15 "N/A" ;
